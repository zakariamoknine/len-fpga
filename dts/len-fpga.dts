/dts-v1/;
/ {
	#address-cells = <2>;
	#size-cells = <2>;

	aliases {
		serial0 = &uart0;
	};

	chosen {
		bootargs = "";
		stdout-path = "serial0";
	};

	cpus {
		#address-cells = <1>;
		#size-cells = <0>;
		timebase-frequency = <100000000>;

		cpu0: cpu@0 {
			device_type = "cpu";
			reg = <0>;
			status = "okay";
			clock-frequency = <100000000>;
			i-cache-size = <32768>;
			d-cache-size = <32768>;
			mmu-type = "riscv,sv39";
			riscv,isa = "rv64imac";
			cpu0_intc: interrupt-controller {
				#interrupt-cells = <1>;
				#address-cells = <0>;
				#size-cells = <0>;
				compatible = "riscv,cpu-intc";
				interrupt-controller;
			};
		};
	};

	memory@80000000 {
		device_type = "memory";
		reg = <0x00000000 0x80000000 0x00000000 0x08000000>;
		status = "okay";
	};

	uart0: serial@44a00000 {
		device_type = "serial";
		compatible = "ns16550a";
		reg = <0x00000000 0x44a00000 0x00000000 0x00010000>;
		status = "okay";
		clock-frequency = <100000000>;
		current-speed = <115200>;
		reg-shift = <2>;
		reg-io-width = <4>;
		reg-offset = <0>
	};

	clint0: clint@30000000 {
		compatible = "sifive,clint0";
		reg = <0x00000000 0x30000000 0x00000000 0x00010000>;
		status = "okay";
		interrupts-extended = <&cpu0_intc 3 &cpu0_intc 7>;
	};
};
